## drivers/input/misc/fpc_fps_mmi/Kconfig
```kconfig
config SENSORS_FPC_1020
	tristate "fpc fingerprint sensor"
	default n
	help
	  Say Y here if you wish to include support for finger print sensor.
	  If unsure, say N.
```

## drivers/misc/abov_mmi_overlay/Kconfig
```kconfig
config ABOV_SAR_MMI_OVERLAY
	tristate "ABOV SAR MMI OVERLAY"
	help
	  This driver can also be built as a module. If so, the module
	  will be called abov_sar_mmi_overlay.
```

## drivers/misc/awinic/aw869xx/Kconfig
```kconfig
#
# AW869XX Driver
#

config AW869XX_HAPTIC
	tristate "Awinic AW869XX haptic driver"
	depends on I2C && INPUT_AWINIC_HAPTIC
	help
	  Say Y here if you have Awinic AW869XX haptic controller
	  chip in your system.

	  If unsure, say N.

	  To compile this driver as a module, choose M here: the
	  module will be called aw869xx.
```

## drivers/nfc/mmi_nfc_clk/Kconfig
```kconfig
config MMI_NFC_CLK
	tristate "Motorola Mobiity NFC Clock Enable/Disable driver"
	---help---
	  Motorola Mobiity NFC Clock Enable/Disable controller support
```

## drivers/nfc/sn1xx/Kconfig
```kconfig
config NFC_I2C_DVR
	tristate "QTI NFC I2C driver"
	---help---
	  QTI NFC I2C driver controller support
```
